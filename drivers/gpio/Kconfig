## drivers/gpio/Kconfig
```kconfig
if DT_HAS_NXP_PCA9555_ENABLED

config CONFIG_GPIO_PCA95XX
  bool "PCA9555 GPIO expander support"
  default y

endif
```

## dts/bindings/gpio/nxp,pca9555.yaml
```yaml
description: NXP PCA9555 I2C GPIO expander

compatible: "nxp,pca9555"

include: nxp,pca_series.yaml

properties:
  ngpios:
    required: true
    const: 16
```
